## main/Kconfig.projbuild
```kconfig
menu "Featured FreeRTOS IoT Integration"
    choice EXAMPLE_PROV_TRANSPORT
        bool "Provisioning Transport"
        default EXAMPLE_PROV_TRANSPORT_SOFTAP
        #default EXAMPLE_PROV_TRANSPORT_BLE
        help
            Wi-Fi provisioning component offers both, SoftAP and BLE transports. Choose any one.

        config EXAMPLE_PROV_TRANSPORT_BLE
            bool "BLE"
            select BT_ENABLED
            depends on !IDF_TARGET_ESP32S2
        config EXAMPLE_PROV_TRANSPORT_SOFTAP
            bool "Soft AP"
            select LWIP_IPV4
    endchoice

    choice EXAMPLE_PROV_SECURITY_VERSION
        bool "Protocomm security version"
        default EXAMPLE_PROV_SECURITY_VERSION_1
        #default EXAMPLE_PROV_SECURITY_VERSION_2
        help
            Wi-Fi provisioning component offers 3 security versions.
            The example offers a choice between security version 1 and 2.

        config EXAMPLE_PROV_SECURITY_VERSION_1
            bool "Security version 1"
            select ESP_PROTOCOMM_SUPPORT_SECURITY_VERSION_1

        config EXAMPLE_PROV_SECURITY_VERSION_2
            bool "Security version 2"
            select ESP_PROTOCOMM_SUPPORT_SECURITY_VERSION_2
    endchoice

    choice EXAMPLE_PROV_MODE
        bool "Security version 2 mode"
        depends on EXAMPLE_PROV_SECURITY_VERSION_2
        default EXAMPLE_PROV_SEC2_DEV_MODE

        config EXAMPLE_PROV_SEC2_DEV_MODE
            bool "Security version 2 development mode"
            depends on EXAMPLE_PROV_SECURITY_VERSION_2
            help
                This enables the development mode for
                security version 2.
                Please note that this mode is NOT recommended for production purpose.

        config EXAMPLE_PROV_SEC2_PROD_MODE
            bool "Security version 2 production mode"
            depends on EXAMPLE_PROV_SECURITY_VERSION_2
            help
                This enables the production mode for
                security version 2.
    endchoice

    config EXAMPLE_PROV_TRANSPORT
        int
        default 1 if EXAMPLE_PROV_TRANSPORT_BLE
        default 2 if EXAMPLE_PROV_TRANSPORT_SOFTAP

    config EXAMPLE_RESET_PROVISIONED
        bool
        default n
        prompt "Reset provisioned status of the device"
        help
            This erases the NVS to reset provisioned status of the device on every reboot.
            Provisioned status is determined by the Wi-Fi STA configuration, saved on the NVS.

    config EXAMPLE_RESET_PROV_MGR_ON_FAILURE
        bool
        default n
        prompt "Reset provisioned credentials and state machine after session failure"
        help
            Enable reseting provisioned credentials and state machine after session failure.
            This will restart the provisioning service after retries are exhausted.

    config EXAMPLE_PROV_MGR_MAX_RETRY_CNT
        int
        default 5
        prompt "Max retries before reseting provisioning state machine"
        depends on EXAMPLE_RESET_PROV_MGR_ON_FAILURE
        help
            Set the Maximum retry to avoid reconnecting to an inexistent AP or if credentials
            are misconfigured. Provisioned credentials are erased and internal state machine
            is reset after this threshold is reached.

    config EXAMPLE_PROV_SHOW_QR
        bool "Show provisioning QR code"
        default y
        help
            Show the QR code for provisioning.

    config EXAMPLE_PROV_USING_BLUEDROID
        bool
        depends on (BT_BLUEDROID_ENABLED && (IDF_TARGET_ESP32C3 || IDF_TARGET_ESP32S3))
        select BT_BLE_42_FEATURES_SUPPORTED
        default y
        help
            This enables BLE 4.2 features for Bluedroid.

    config EXAMPLE_REPROVISIONING
        bool "Re-provisioning"
        help
            Enable re-provisioning - allow the device to provision for new credentials
            after previous successful provisioning.

    config GRI_RUN_QUALIFICATION_TEST
        bool "Run qualification test."
        default n
        help
            Enable to run qualification test. Use configurations in test_execution_config.h and test_param_config.h.
            Disable to demo. Use configurations below (in sdkconfig).

    menu "Qualification Test Configurations"

        menu "Qualification Execution Test Configurations"
            config GRI_DEVICE_ADVISOR_TEST_ENABLED
                bool "Device Advisor Test."
                default n

            config GRI_MQTT_TEST_ENABLED
                bool "MQTT Test."
                default n

            config GRI_TRANSPORT_INTERFACE_TEST_ENABLED
                bool "Transport Interface Test."
                default n

            config GRI_OTA_PAL_TEST_ENABLED
                bool "OTA PAL Test."
                default n

            config GRI_OTA_E2E_TEST_ENABLED
                bool "OTA end-to-end Test."
                default n

            config GRI_CORE_PKCS11_TEST_ENABLED
                bool "CorePKCS#11 Test."
                default n

        endmenu # "Qualification Execution Test Configurations"

        menu "Qualification Parameter Configurations"
            config GRI_QUALIFICATION_FORCE_GENERATE_NEW_KEY_PAIR
                bool "Generate a key pair."
                default n
            
            config GRI_QUALIFICATION_MQTT_ENDPOINT
                string "Endpoint for MQTT Broker to use"
                default "a3rth2hxbir85k-ats.iot.eu-central-1.amazonaws.com"
                help
                    MQTT Broker for Device Advisor Test/MQTT Test/OTA end-to-end Test.

            config GRI_QUALIFICATION_MQTT_PORT
                int "Port for MQTT Broker to use"
                default 8883
            
            config GRI_QUALIFICATION_CLIENT_IDENTIFIER
                string "Client Identifier for MQTT Test"
                default "testClient"
            
            config GRI_QUALIFICATION_NETWORK_BUFFER_SIZE
                int "Network Buffer Size for MQTT Test"
                default 5000
            
            config GRI_QUALIFICATION_PROCESS_LOOP_TIMEOUT_MS
                int "Timeout to run MQTT process loop for MQTT Test"
                default 700
            
            config GRI_QUALIFICATION_ECHO_SERVER
                string "Echo Server Domain Name/IP for Transport Interface Test"
                default "PLACE_HOLDER"
                help
                    Domain Name or IP address for Transport Interface Test.

            config GRI_QUALIFICATION_ECHO_SERVER_PORT
                int "Port for Echo Server to use"
                default 9000
            
            config GRI_QUALIFICATION_OTA_PAL_CERTIFICATE_FILE
                string "Path to cert for OTA PAL Test."
                default ""
            
            config GRI_QUALIFICATION_OTA_PAL_FIRMWARE_FILE
                string "Path to store firmware for OTA PAL Test."
                default "/"
            
            config GRI_QUALIFICATION_OTA_PAL_USE_FILE_SYSTEM
                bool "Use File System for OTA PAL Test."
                default n
            
            config GRI_QUALIFICATION_THING_NAME
                string "Thing Name for Device Advisor Test/OTA end-to-end Test"
                default "C2023D240AC4000110"
            
            config GRI_QUALIFICATION_OTA_APP_VERSION_MAJOR
                int "Application version major for OTA end-to-end Test."
                default 0
            
            config GRI_QUALIFICATION_OTA_APP_VERSION_MINOR
                int "Application version minor for OTA end-to-end Test."
                default 9
            
            config GRI_QUALIFICATION_OTA_APP_VERSION_BUILD
                int "Application version build for OTA end-to-end Test."
                default 0
        endmenu # "Qualification Parameter Configurations"
        
        menu "Sub pub unsub demo configurations"
            config GRI_SUB_PUB_UNSUB_DEMO_STRING_BUFFER_LENGTH
                int "Topic name and payload buffer length"
                default 100
                help
                    Size of statically allocated buffers for holding topic names and payloads.

            config GRI_SUB_PUB_UNSUB_DEMO_DELAY_BETWEEN_SUB_PUB_UNSUB_LOOPS_MS
                int "Delay between sub pub unsub loops in milliseconds"
                default 5000
                help
                    Delay for each task between subscription, publish, unsubscription loops.

            config GRI_SUB_PUB_UNSUB_DEMO_MAX_COMMAND_SEND_BLOCK_TIME_MS
                int "coreMQTT-Agent command post block time in milliseconds."
                default 500
                help
                    The maximum amount of time in milliseconds to wait for the commands to be posted to the MQTT agent should the MQTT agent's command queue be full. Tasks wait in the Blocked state, so don't use any CPU time.
            
            config GRI_SUB_PUB_UNSUB_DEMO_QOS_LEVEL
                int "QoS level of MQTT operations"
                default 0
                range 0 2
                help
                    The QoS level of MQTT messages sent by this demo. This must be 0 or 1 if using AWS as AWS only supports levels 0 or 1. If using another MQTT broker, that supports QoS level 2, this can be set to 2.
        
            config GRI_SUB_PUB_UNSUB_DEMO_NUM_TASKS_TO_CREATE
                int "Number of SubPubUnsub tasks to create"
                default 1
                help
                    The number of SubPubUnsub tasks to create for this demo.

            config GRI_SUB_PUB_UNSUB_DEMO_TASK_PRIORITY
                int "SubPubUnsub task priority."
                default 1
                help
                    The task priority of each of the SubPubUnsub tasks.

            config GRI_SUB_PUB_UNSUB_DEMO_TASK_STACK_SIZE
                int "SubPubUnsub task stack size."
                default 3072
                help
                    The task stack size for each of the SubPubUnsub tasks.
        
        endmenu # Sub pub unsub demo configurations

        menu "OTA demo configurations"
            config GRI_OTA_DEMO_MAX_FILE_PATH_SIZE
                int "Max file path size."
                default 260
                help
                    The maximum size of the file paths used in the demo.

            config GRI_OTA_DEMO_MAX_STREAM_NAME_SIZE
                int "Max stream name size."
                default 128
                help
                    The maximum size of the stream name required for downloading update file from streaming service.
            
            config GRI_OTA_DEMO_TASK_DELAY_MS
                int "OTA statistic output delay milliseconds."
                default 1000
                help
                    The delay used in the OTA demo task to periodically output the OTA statistics like number of packets received, dropped, processed and queued per connection.

            config GRI_OTA_DEMO_MQTT_TIMEOUT_MS
                int "MQTT operation timeout milliseconds."
                default 5000
                help
                    The maximum time for which OTA demo waits for an MQTT operation to be complete. This involves receiving an acknowledgment for broker for SUBSCRIBE, UNSUBSCRIBE and non QOS0 publishes.

            config GRI_OTA_DEMO_AGENT_TASK_PRIORITY
                int "OTA agent task priority."
                default 4

            config GRI_OTA_DEMO_AGENT_TASK_STACK_SIZE
                int "OTA agent task stack size."
                default 4096

            config GRI_OTA_DEMO_DEMO_TASK_PRIORITY
                int "OTA demo task priority."
                default 1
        
            config GRI_OTA_DEMO_DEMO_TASK_STACK_SIZE
                int "OTA demo task stack size."
                default 3072

        endmenu # OTA demo configurations
    endmenu # Qualification Test Configurations

    config GRI_MQTT_ENDPOINT
        string "Endpoint for MQTT Broker to use"
        depends on !GRI_RUN_QUALIFICATION_TEST
        default "a3rth2hxbir85k-ats.iot.eu-central-1.amazonaws.com"

    config GRI_MQTT_PORT
        int "Port for MQTT Broker to use"
        depends on !GRI_RUN_QUALIFICATION_TEST
        default 8883

    config GRI_THING_NAME
        string "Thing name"
        depends on !GRI_RUN_QUALIFICATION_TEST
        default "testClient"

    config GRI_OUTPUT_CERTS_KEYS
        bool "Output provisioned certificates and keys."
        default n

    menu "coreMQTT-Agent Manager Configurations"

        config GRI_MQTT_AGENT_TASK_STACK_SIZE
            int "coreMQTT-Agent task stack size"
            default 4096

        config GRI_MQTT_AGENT_TASK_PRIORITY
            int "coreMQTT-Agent task priority"
            default 4

        config GRI_CONNECTION_TASK_STACK_SIZE
            int "Connection handling task stack size"
            default 3072

        config GRI_CONNECTION_TASK_PRIORITY
            int "Connection handling task priority"
            default 4

        config GRI_RETRY_MAX_BACKOFF_DELAY_MS
            int "Maximum backoff delay on connection retry in milliseconds"
            default 5000

        config GRI_RETRY_BACKOFF_BASE_MS
            int "Base back-off delay on connection retry in milliseconds"
            default 500

        config GRI_MQTT_AGENT_NETWORK_BUFFER_SIZE
            int "coreMQTT-Agent network buffer size"
            default 10000

        config GRI_MQTT_AGENT_COMMAND_QUEUE_LENGTH
            int "coreMQTT-Agent command queue length"
            default 10

        config GRI_MQTT_AGENT_KEEP_ALIVE_INTERVAL_SECONDS
            int "coreMQTT-Agent keep alive interval in seconds"
            default 1200
            help
                The maximum time interval in seconds which is allowed to elapsed between two Control Packets.

        config GRI_MQTT_AGENT_CONNACK_RECV_TIMEOUT_MS
            int "Timeout for receiving CONNACK in milliseconds"
            default 1000

        
    endmenu # coreMQTT-Agent Manager Configurations

    config GRI_ENABLE_SUB_PUB_UNSUB_DEMO
        bool "Enable pub sub unsub demo"
        depends on !GRI_RUN_QUALIFICATION_TEST
        default y

    menu "Sub pub unsub demo configurations"
        depends on GRI_ENABLE_SUB_PUB_UNSUB_DEMO

        config GRI_SUB_PUB_UNSUB_DEMO_STRING_BUFFER_LENGTH
            int "Topic name and payload buffer length"
            default 100
            help
                Size of statically allocated buffers for holding topic names and payloads.

        config GRI_SUB_PUB_UNSUB_DEMO_DELAY_BETWEEN_SUB_PUB_UNSUB_LOOPS_MS
            int "Delay between sub pub unsub loops in milliseconds"
            default 5000
            help
                Delay for each task between subscription, publish, unsubscription loops.

        config GRI_SUB_PUB_UNSUB_DEMO_MAX_COMMAND_SEND_BLOCK_TIME_MS
            int "coreMQTT-Agent command post block time in milliseconds."
            default 500
            help
                The maximum amount of time in milliseconds to wait for the commands to be posted to the MQTT agent should the MQTT agent's command queue be full. Tasks wait in the Blocked state, so don't use any CPU time.
        
        config GRI_SUB_PUB_UNSUB_DEMO_QOS_LEVEL
            int "QoS level of MQTT operations"
            default 1
            range 0 2
            help
                The QoS level of MQTT messages sent by this demo. This must be 0 or 1 if using AWS as AWS only supports levels 0 or 1. If using another MQTT broker, that supports QoS level 2, this can be set to 2.
    
        config GRI_SUB_PUB_UNSUB_DEMO_NUM_TASKS_TO_CREATE
            int "Number of SubPubUnsub tasks to create"
            default 1
            help
                The number of SubPubUnsub tasks to create for this demo.

        config GRI_SUB_PUB_UNSUB_DEMO_TASK_PRIORITY
            int "SubPubUnsub task priority."
            default 1
            help
                The task priority of each of the SubPubUnsub tasks.

        config GRI_SUB_PUB_UNSUB_DEMO_TASK_STACK_SIZE
            int "SubPubUnsub task stack size."
            default 3072
            help
                The task stack size for each of the SubPubUnsub tasks.
    
    endmenu # Sub pub unsub demo configurations
    
    config GRI_ENABLE_TEMPERATURE_PUB_SUB_AND_LED_CONTROL_DEMO
        bool "Enable temperature sensor pub sub and LED control demo"
        depends on !GRI_RUN_QUALIFICATION_TEST
        default y

    menu "Temperature pub sub and LED control demo configurations"
        depends on GRI_ENABLE_TEMPERATURE_PUB_SUB_AND_LED_CONTROL_DEMO

        choice GRI_TEMPERATURE_PUB_SUB_AND_LED_CONTROL_DEMO_LED_TYPE
            prompt "LED type"
            default GRI_TEMPERATURE_PUB_SUB_AND_LED_CONTROL_DEMO_LED_GPIO if IDF_TARGET_ESP32 || IDF_TARGET_ESP32C2
            default GRI_TEMPERATURE_PUB_SUB_AND_LED_CONTROL_DEMO_LED_RMT
            help
                Defines the default peripheral for the GRI

            config GRI_TEMPERATURE_PUB_SUB_AND_LED_CONTROL_DEMO_LED_GPIO
                bool "GPIO"
            config GRI_TEMPERATURE_PUB_SUB_AND_LED_CONTROL_DEMO_LED_RMT
                bool "RMT - Addressable LED"
        endchoice

        config GRI_TEMPERATURE_PUB_SUB_AND_LED_CONTROL_DEMO_LED_GPIO_NUMBER
            int "GRI GPIO number"
            default 8 if IDF_TARGET_ESP32C3 || IDF_TARGET_ESP32H2 || IDF_TARGET_ESP32C2
            default 18 if IDF_TARGET_ESP32S2
            default 48 if IDF_TARGET_ESP32S3
            default 5
            help
                GPIO number (IOxx) to blink on and off or the RMT signal for the addressable LED.
                Some GPIOs are used for other purposes (flash connections, etc.) and cannot be used for LED.

        config GRI_TEMPERATURE_PUB_SUB_AND_LED_CONTROL_DEMO_STRING_BUFFER_LENGTH
            int "Topic name and payload buffer length"
            default 150
            help
                Size of statically allocated buffers for holding topic names and payloads.

        config GRI_TEMPERATURE_PUB_SUB_AND_LED_CONTROL_DEMO_DELAY_BETWEEN_PUBLISH_OPERATIONS_MS
            int "Delay between publishes in milliseconds"
            default 3000
            help
                Delay for the synchronous publisher task between publishes.

        config GRI_TEMPERATURE_PUB_SUB_AND_LED_CONTROL_DEMO_MAX_COMMAND_SEND_BLOCK_TIME_MS
            int "coreMQTT-Agent command post block time in milliseconds."
            default 500
            help
                The maximum amount of time in milliseconds to wait for the commands to be posted to the MQTT agent should the MQTT agent's command queue be full. Tasks wait in the Blocked state, so don't use any CPU time.
        
        config GRI_TEMPERATURE_PUB_SUB_AND_LED_CONTROL_DEMO_QOS_LEVEL
            int "QoS level of MQTT operations"
            default 1
            range 0 2
            help
                The QoS level of MQTT messages sent by this demo. This must be 0 or 1 if using AWS as AWS only supports levels 0 or 1. If using another MQTT broker, that supports QoS level 2, this can be set to 2.

        config GRI_TEMPERATURE_PUB_SUB_AND_LED_CONTROL_DEMO_TASK_PRIORITY
            int "Temperature sensor publishing task priority."
            default 1
            help
                The task priority of the temperature sensor publishing task.

        config GRI_TEMPERATURE_PUB_SUB_AND_LED_CONTROL_DEMO_TASK_STACK_SIZE
            int "Temperature sensor publishing task stack size."
            default 3072
            help
                The task stack size of the temperature sensor publishing task.

    endmenu # Temperature pub sub and LED control demo configurations

    config GRI_ENABLE_OTA_DEMO
        bool "Enable OTA demo"
        depends on !GRI_RUN_QUALIFICATION_TEST
        default y
    
    menu "OTA demo configurations"
        depends on GRI_ENABLE_OTA_DEMO

        config GRI_OTA_DEMO_MAX_FILE_PATH_SIZE
            int "Max file path size."
            default 260
            help
                The maximum size of the file paths used in the demo.

        config GRI_OTA_DEMO_MAX_STREAM_NAME_SIZE
            int "Max stream name size."
            default 128
            help
                The maximum size of the stream name required for downloading update file from streaming service.
        
        config GRI_OTA_DEMO_TASK_DELAY_MS
            int "OTA statistic output delay milliseconds."
            default 1000
            help
                The delay used in the OTA demo task to periodically output the OTA statistics like number of packets received, dropped, processed and queued per connection.

        config GRI_OTA_DEMO_MQTT_TIMEOUT_MS
            int "MQTT operation timeout milliseconds."
            default 5000
            help
                The maximum time for which OTA demo waits for an MQTT operation to be complete. This involves receiving an acknowledgment for broker for SUBSCRIBE, UNSUBSCRIBE and non QOS0 publishes.

        config GRI_OTA_DEMO_AGENT_TASK_PRIORITY
            int "OTA agent task priority."
            default 4

        config GRI_OTA_DEMO_AGENT_TASK_STACK_SIZE
            int "OTA agent task stack size."
            default 4096

        config GRI_OTA_DEMO_DEMO_TASK_PRIORITY
            int "OTA demo task priority."
            default 1
    
        config GRI_OTA_DEMO_DEMO_TASK_STACK_SIZE
            int "OTA demo task stack size."
            default 3072

        config GRI_OTA_DEMO_APP_VERSION_MAJOR
            int "Application version major."
            default 0

        config GRI_OTA_DEMO_APP_VERSION_MINOR
            int "Application version minor."
            default 0

        config GRI_OTA_DEMO_APP_VERSION_BUILD
            int "Application version build."
            default 0

    endmenu # OTA demo configurations

endmenu # Golden Reference Integration 


menu "ESP Secure Cert Manager"
    config ESP_SECURE_CERT_SUPPORT_LEGACY_FORMATS
        bool "Enable support for legacy format"
        default y
        help
            Enable support for legacy format certs
endmenu 


menu "Mesh Configuration"

    choice ESPNOW_WIFI_MODE
        prompt "WiFi mode"
        default ESPNOW_WIFI_MODE_STATION
        help
            WiFi mode(station or softap).

        config ESPNOW_WIFI_MODE_STATION
            bool "Station"
        config ESPNOW_WIFI_MODE_STATION_SOFTAP
            bool "Softap"
    endchoice

    config ESPNOW_PMK
        string "ESPNOW primary master key"
        default "pmk1234567890123"
        help
            ESPNOW primary master for the example to use. The length of ESPNOW primary master must be 16 bytes.

    config ESPNOW_LMK
        string "ESPNOW local master key"
        default "lmk1234567890123"
        help
            ESPNOW local master for the example to use. The length of ESPNOW local master must be 16 bytes.

    config ESPNOW_CHANNEL
        int "Channel"
        default 1
        range 0 14
        help
            The channel on which sending and receiving ESPNOW data.

    config ESPNOW_SEND_COUNT
        int "Send count"
        default 100
        range 1 65535
        help
            Total count of unicast ESPNOW data to be sent.

    config ESPNOW_SEND_DELAY
        int "Send delay"
        default 1000
        range 0 65535
        help
            Delay between sending two ESPNOW data, unit: ms.

    config ESPNOW_SEND_LEN
        int "Send len"
        range 10 250
        default 10
        help
            Length of ESPNOW data to be sent, unit: byte.

    config ESPNOW_ENABLE_LONG_RANGE
        bool "Enable Long Range"
        default "y"
        help
            When enable long range, the PHY rate of ESP32 will be 512Kbps or 256Kbps

    config ESPNOW_ENABLE_POWER_SAVE
        bool "Enable ESPNOW Power Save"
        default "y"
        select ESP_WIFI_STA_DISCONNECTED_PM_ENABLE
        depends on ESPNOW_WIFI_MODE_STATION
        help
            With ESPNOW power save enabled, chip would be able to wakeup and sleep periodically
            Notice ESP_WIFI_STA_DISCONNECTED_PM_ENABLE is essential at Wi-Fi disconnected

    config ESPNOW_WAKE_WINDOW
        int "ESPNOW wake window, unit in millisecond"
        range 0 65535
        default 100
        depends on ESPNOW_ENABLE_POWER_SAVE
        help
            ESPNOW wake window

    config ESPNOW_WAKE_INTERVAL
        int "ESPNOW wake interval, unit in millisecond"
        range 1 65535
        default 1000
        depends on ESPNOW_ENABLE_POWER_SAVE
        help
            ESPNOW wake interval

endmenu
```
